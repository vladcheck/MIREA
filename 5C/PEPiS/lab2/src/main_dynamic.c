#include "stm32f4xx.h"

// Лабораторная работа № 2, вариант 4.
// Динамическая (мультиплексная) индикация: четырёхзначное число — текущий год 2026.
// Схема: сегменты a-g -> PA0-PA6 (активный высокий уровень),
// разряды -> PC0-PC3 через ключевые транзисторы NPN (активный высокий уровень).
// Сегментные линии объединены параллельно для всех разрядов; разряды включаются
// поочерёдно высоким уровнем. За счёт инерции зрения цифры воспринимаются
// горящими одновременно. Перед сменой кода все разряды гасятся низким уровнем,
// чтобы исключить наложение изображений соседних цифр.

// Таблица кодов сегментов для цифр 0-9 (вариант с общим катодом, табл. 1 методички).
// Отображение бит на выводы: бит0=a (PA0), ..., бит6=g (PA6).
static const uint8_t digit_code[10] = {
    0x3F, // 0 -> a b c d e f
    0x06, // 1 -> b c
    0x5B, // 2 -> a b d e g
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    0x7F, // 8 -> a b c d e f g
    0x6F  // 9 -> a b c d f g
};

// Число для отображения: текущий год (разряды слева направо: тысячи -> единицы)
static const int number[4] = {2, 0, 2, 6};

// Программная задержка удержания разряда (~1-5 мс на разряд).
static void delay(volatile uint32_t t) {
    while (t--) __NOP();
}

int main(void) {
    // 1. Включаем тактирование портов A и C (шина AHB1).
    //    Фиктивное чтение — дождаться стабилизации тактирования,
    //    прежде чем обращаться к регистрам GPIO.
    RCC->AHB1ENR |= RCC_AHB1ENR_GPIOAEN | RCC_AHB1ENR_GPIOCEN;
    volatile uint32_t tmp = RCC->AHB1ENR;
    (void)tmp;

    // 2. Настраиваем PA0-PA6 (сегменты a-g) как выходы push-pull
    for (int i = 0; i <= 6; i++) {
        GPIOA->MODER   &= ~(0x3U << (i * 2U)); // очистить поле режима
        GPIOA->MODER   |=  (0x1U << (i * 2U)); // 01 — выход
        GPIOA->OTYPER  &= ~(1U << i);          // 0 — push-pull
        GPIOA->OSPEEDR &= ~(0x3U << (i * 2U)); // 00 — низкая скорость
        GPIOA->PUPDR   &= ~(0x3U << (i * 2U)); // 00 — без подтяжки
    }

    // 3. Настраиваем PC0-PC3 (катоды разрядов) как выходы push-pull
    for (int i = 0; i < 4; i++) {
        GPIOC->MODER   &= ~(0x3U << (i * 2U));
        GPIOC->MODER   |=  (0x1U << (i * 2U)); // 01 — выход
        GPIOC->OTYPER  &= ~(1U << i);          // 0 — push-pull
        GPIOC->OSPEEDR &= ~(0x3U << (i * 2U));
        GPIOC->PUPDR   &= ~(0x3U << (i * 2U));
    }

    while (1) {
        // 4. Перебираем разряды слева направо
        for (int pos = 0; pos < 4; pos++) {
            // Гасим все разряды (PC0-PC3 = «0», ключи закрыты),
            // чтобы исключить наложение изображений соседних цифр.
            // Старшие 16 бит BSRR атомарно сбрасывают линии в «0».
            GPIOC->BSRR = (0xFU << 16U);

            // Подаём код цифры на сегменты (PA0-PA6).
            // Маска 0xFF80 сохраняет состояние PA7-PA15.
            GPIOA->ODR = (GPIOA->ODR & 0xFF80U) | digit_code[number[pos]];

            // Включаем нужный разряд (PCpos = «1», ключ открыт).
            // Младшие 16 бит BSRR атомарно устанавливают линию в «1».
            GPIOC->BSRR = (1U << pos);

            // Удержание разряда. Частота обновления всего индикатора
            // порядка 100-150 Гц — мерцание незаметно глазу.
            delay(1500);
        }
    }
}
