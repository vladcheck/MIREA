#include "stm32f4xx.h"

// Лабораторная работа № 2, вариант 4.
// Статическая индикация: цифра «4» (номер варианта) на одном разряде.
// Схема: сегменты a-g -> PA0-PA6 (активный высокий уровень),
// общие катоды разрядов -> PC0-PC3 через ключевые транзисторы NPN,
// поэтому разряд включается ВЫСОКИМ уровнем на PCx («1»),
// а гасится НИЗКИМ («0»). Неиспользуемые разряды держать в «0».

// Таблица кодов сегментов для цифр 0-9 (вариант с общим катодом, табл. 1 методички).
// Отображение бит на выводы: бит0=a (PA0), бит1=b (PA1), ..., бит6=g (PA6).
static const uint8_t digit_code[10] = {
    0x3F, // 0 -> a b c d e f
    0x06, // 1 -> b c
    0x5B, // 2 -> a b d e g
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    0x7F, // 8 -> a b c d e f g
    0x6F  // 9 -> a b c d f g
};

// Программная задержка. Параметр volatile запрещает компилятору удалять цикл.
static void delay(volatile uint32_t t) {
    while (t--) __NOP();
}

int main(void) {
    // 1. Включаем тактирование портов A и C (шина AHB1).
    //    Фиктивное чтение — дождаться стабилизации тактирования,
    //    прежде чем обращаться к регистрам GPIO.
    RCC->AHB1ENR |= RCC_AHB1ENR_GPIOAEN | RCC_AHB1ENR_GPIOCEN;
    volatile uint32_t tmp = RCC->AHB1ENR;
    (void)tmp;

    // 2. Настраиваем PA0-PA6 (сегменты a-g) как выходы push-pull,
    //    низкая скорость, без подтяжек
    for (int i = 0; i <= 6; i++) {
        GPIOA->MODER   &= ~(0x3U << (i * 2U)); // очистить поле режима
        GPIOA->MODER   |=  (0x1U << (i * 2U)); // 01 — выход
        GPIOA->OTYPER  &= ~(1U << i);          // 0 — push-pull
        GPIOA->OSPEEDR &= ~(0x3U << (i * 2U)); // 00 — низкая скорость
        GPIOA->PUPDR   &= ~(0x3U << (i * 2U)); // 00 — без подтяжки
    }

    // 3. Настраиваем PC0-PC3 (ключи разрядов) как выходы push-pull.
    //    Все разряды сразу гасим низким уровнем («0»), иначе
    //    неиспользуемые разряды останутся «висеть в воздухе».
    for (int i = 0; i < 4; i++) {
        GPIOC->MODER   &= ~(0x3U << (i * 2U));
        GPIOC->MODER   |=  (0x1U << (i * 2U)); // 01 — выход
        GPIOC->OTYPER  &= ~(1U << i);          // 0 — push-pull
        GPIOC->OSPEEDR &= ~(0x3U << (i * 2U));
        GPIOC->PUPDR   &= ~(0x3U << (i * 2U));
    }
    GPIOC->BSRR = (0xFU << 16U); // PC0-PC3 = «0», все разряды погашены

    // 4. Вариант 4: отображаемая цифра — «4»
    const int digit = 4;

    while (1) {
        // 5. Подаём код цифры на линии сегментов (PA0-PA6).
        //    Маска 0xFF80 сохраняет состояние PA7-PA15.
        GPIOA->ODR = (GPIOA->ODR & 0xFF80U) | digit_code[digit];

        // 6. Включаем разряд 0 высоким уровнем на PC0.
        //    Младшие 16 бит BSRR атомарно устанавливают линию в «1».
        GPIOC->BSRR = (1U << 0U);

        delay(400000); // задержка для наблюдения (статический режим)
    }
}
