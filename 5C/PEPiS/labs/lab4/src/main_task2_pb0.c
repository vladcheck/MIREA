#include <avr/io.h>
#include <util/delay.h>
#include <stdint.h>

// Лабораторная работа №4, задача 2.
// Входной сигнал бит 0 порта B (кнопка замыкает PB0 на GND, включена
// внутренняя подтяжка: отпущена дает 1, нажата дает 0).
// Выход порт C: при PB0 равном 0 включены два младших светодиода (0x03),
// при PB0 равном 1 включены два старших разряда (0xC0).
// Опрос с антидребезгом: состояние принимается после двух совпадений
// подряд с паузой 5 мс.

static uint8_t read_pb0(void)
{
    uint8_t first = (PINB & 0x01);
    _delay_ms(5);
    if ((PINB & 0x01) != first)
        return 2; // дребезг, состояние не определено
    return first;
}

int main(void)
{
    DDRB &= (uint8_t)~0x01; // бит 0 порта B на вход
    PORTB |= 0x01;          // подтяжка PB0
    DDRC = 0xFF;            // порт C на выход
    PORTC = 0x03;           // исходное состояние, два младших
    while (1)
    {
        uint8_t b = read_pb0();
        if (b == 0)
            PORTC = 0x03; // PB0 замкнут, два младших светодиода
        else if (b == 1)
            PORTC = 0xC0; // PB0 отпущен, два старших разряда
    }
}
