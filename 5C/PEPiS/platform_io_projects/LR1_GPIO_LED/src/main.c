/**
 ******************************************************************************
 * ЛР №1. Знакомство со стендом. Управление портами ввода-вывода (GPIO)
 * МК: STM32F407VGT6 (учебный стенд DIS_F407VG), код на регистрах CMSIS
 *
 * Схема подключения: светодиоды РА0-РА7 (младший байт порта А).
 *
 * Режим работы задаётся макросом MODE:
 *   1 - мигание одним светодиодом (РА0) - базовый пример 3.2;
 *   2 - "бегущий огонь" РА0 -> РА7 - базовый пример 4.2;
 *   3 - бегущий огонь в обратную сторону (РА7 -> РА0) - задание 1;
 *   4 - двухсторонний огонь: от центра к краям и обратно - задание 2;
 *   5 - мигание РА0, скорость регулируется DELAY_LOOPS - задание 3.
 * Задержка калибрована под HSI=16 МГц (после сброса PLL не настроен).
 ******************************************************************************
 */
#include "stm32f4xx.h"

/* Выбор режима (1-5), можно переопределить сборкой: pio run с build_flags = -DMODE=n */
#ifndef MODE
#define MODE 2
#endif

/* Константы программной задержки (HSI = 16 МГц, ~0.2 мкс на итерацию):
 * BLINK_DELAY - полупериод мигания (~0.8 с -> период ~1.6 с, как в методичке
 *               "период около 1 секунды" - подбирается в задании 3);
 * RUN_DELAY   - шаг бегущего огня (~40 мс). */
#define BLINK_DELAY 4000000U
#define RUN_DELAY    200000U

/* Программная задержка: пустой цикл с NOP, volatile запрещает
 * оптимизатору удалить цикл как "ничего не делающий". */
void delay(volatile uint32_t t)
{
    while (t--) {
        __NOP();
    }
}

/* Включение тактирования и настройка РА0-РА7:
 * выход push-pull, низкая скорость ( slew rate ), без подтяжек. */
static void gpio_init(void)
{
    /* 1. Тактирование GPIOA (на шине AHB1, в отличие от APB2 у STM32F1) */
    RCC->AHB1ENR |= RCC_AHB1ENR_GPIOAEN;

    /* 2. По двум битам на пин: MODER=01 (выход), OTYPER=0 (push-pull),
     *    OSPEEDR=00 (низкая скорость), PUPDR=00 (без подтяжки) */
    for (int i = 0; i <= 7; i++) {
        GPIOA->MODER   &= ~(0x3U << (i * 2U));  /* очистить поле режима  */
        GPIOA->MODER   |=  (0x1U << (i * 2U));  /* 01 = выход            */
        GPIOA->OTYPER  &= ~(1U   << i);         /* 0  = push-pull        */
        GPIOA->OSPEEDR &= ~(0x3U << (i * 2U));  /* 00 = низкая скорость  */
        GPIOA->PUPDR   &= ~(0x3U << (i * 2U));  /* 00 = без подтяжки     */
    }

    /* 3. Погасить все светодиоды */
    GPIOA->BSRR = (0xFFU << 16); /* старшие 16 бит BSRR = сброс РА0-РА7 */
}

/* Запись шаблона в младший байт ODR, старшие биты порта не трогаем.
 * Маска 0xFF00 сохраняет состояние РА8-РА15 (см. контрольный вопрос 3). */
static inline void leds_write(uint8_t pattern)
{
    GPIOA->ODR = (GPIOA->ODR & 0xFF00U) | pattern;
}

int main(void)
{
    gpio_init();

#if MODE == 1
    /* === Базовый пример 3.2: мигание светодиодом на РА0 === */
    while (1) {
        GPIOA->BSRR = (1U << 0U);           /* РА0 = 1 -> светодиод ВКЛ  */
        delay(BLINK_DELAY);
        GPIOA->BSRR = (1U << (0U + 16U));   /* РА0 = 0 -> светодиод ВЫКЛ */
        delay(BLINK_DELAY);
    }

#elif MODE == 2
    /* === Базовый пример 4.2: бегущий огонь РА0 -> РА7 === */
    uint8_t pattern = 0x01U;                /* старт с РА0 */
    while (1) {
        leds_write(pattern);
        delay(RUN_DELAY);
        pattern <<= 1;                      /* сдвиг "огня" к старшим пинам */
        if (pattern == 0U) {
            pattern = 0x01U;                /* после РА7 вернуться к РА0 */
        }
    }

#elif MODE == 3
    /* === Задание 1: бегущий огонь в обратную сторону, РА7 -> РА0 === */
    uint8_t pattern = 0x80U;                /* старт с РА7 */
    while (1) {
        leds_write(pattern);
        delay(RUN_DELAY);
        pattern >>= 1;                      /* сдвиг "огня" к младшим пинам */
        if (pattern == 0U) {
            pattern = 0x80U;                /* после РА0 вернуться к РА7 */
        }
    }

#elif MODE == 4
    /* === Задание 2: двухсторонний огонь — от центра к краям и обратно === */
    uint8_t pos = 0;                        /* 0..3: расстояние от центра */
    int8_t dir  = +1;                       /* старт ОТ центра: +1 к краям */
    while (1) {
        /* Два бита симметрично относительно границы РА3/РА4 */
        uint8_t pattern = (uint8_t)((1U << (3U - pos)) | (1U << (4U + pos)));
        leds_write(pattern);
        delay(RUN_DELAY);
        pos = (uint8_t)((int8_t)pos + dir);
        if (pos == 3U) {
            dir = -1;                       /* дошли до краев (РА0 и РА7) - назад */
        } else if (pos == 0U) {
            dir = +1;                       /* встретились в центре - к краям */
        }
    }

#elif MODE == 5
    /* === Задание 3: мигание РА0, скорость подбирается константой BLINK_DELAY ===
     * Скорость меняется перекомпиляцией: чем меньше константа, тем быстрее.
     * При слишком малой константе мигание сольётся в постоянное свечение
     * (превышение критической частоты мерцания ~50 Гц). */
    while (1) {
        GPIOA->BSRR = (1U << 0U);
        delay(BLINK_DELAY);
        GPIOA->BSRR = (1U << (0U + 16U));
        delay(BLINK_DELAY);
    }

#endif
}
