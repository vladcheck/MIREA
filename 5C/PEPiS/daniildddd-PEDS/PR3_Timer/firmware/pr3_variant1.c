/* ПР №3, Вариант 1: P1.3, S=2с ON / K=1с OFF, T=3мин (60 циклов)
 * МК-51, Fosc=12МГц -> Tмаш=1мкс. T/C0, режим 1, база 50мс.
 * Перезагрузка: 65536-50000=15536=0x3CB0 -> TH0=0x3C, TL0=0xB0.
 * S=40x50мс, K=20x50мс. Опрос TF0 (программный режим).
 * P1.3 трогаем маской 0x08, остальные биты порта сохраняем.
 * Компиляторы: Keil C51 (#include <REG51.H>) или SDCC (#include <8051.h>).
 */
#include <8051.h>   /* для Keil заменить на <REG51.H> */

/* Задержка n раз по 50мс на T/C0 в режиме 1.
 * n=40 -> 2.0с (S), n=20 -> 1.0с (K). */
void delay50ms(unsigned char n)
{
    unsigned char i;
    for (i = 0; i < n; i++) {
        TH0 = 0x3C;   /* старший байт -50000 (50мс при 12МГц) */
        TL0 = 0xB0;   /* младший байт -50000 */
        TR0 = 1;      /* пуск T/C0 (TCON.4) */
        while (TF0 == 0); /* ждать переполнения 50мс */
        TF0 = 0;      /* сбросить флаг TF0 (TCON.5) */
        TR0 = 0;      /* остановить таймер */
    }
}

void main(void)
{
    unsigned char cyc;
    TMOD = 0x01;      /* T/C0: таймер, режим 1 (M1M0=01) */
    TF0 = 0; TR0 = 0; /* исходное состояние таймера */
    P1 &= ~0x08;      /* P1.3=0: HL1 погашен */

    /* 60 циклов по 3с = 180с = 3мин (T) */
    for (cyc = 0; cyc < 60; cyc++) {
        P1 |= 0x08;       /* P1.3=1: зажечь HL1 (ток ~11мА через R1 270 Ом) */
        delay50ms(40);    /* держать S=2с */
        P1 &= ~0x08;      /* P1.3=0: погасить HL1 */
        delay50ms(20);    /* держать K=1с */
    }

    P1 &= ~0x08;      /* оставить погашенным после T */
    while (1);        /* останов */
}
