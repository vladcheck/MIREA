#include <avr/io.h>
#include <util/delay.h>
#include <stdint.h>

// Лабораторная работа №4, задача 5, подпункт г (вариант 4): JK-триггер.
// Входы: PA0 равен J, PA1 равен K, PA2 тактовый (кнопки на GND,
// нажатая кнопка после инверсии дает 1).
// Выходы: PD0 равен Q, PD1 равен инверсии Q (светодиоды).
// Тактирование по нажатию кнопки C (переход 1 к 0 после инверсии
// выглядит как фронт 0 к 1) с антидребезгом 20 мс.
// Таблица JK: 00 хранение, 01 сброс, 10 установка, 11 переключение.

int main(void)
{
    uint8_t q = 0;
    uint8_t prev_c = 0;
    DDRA = 0x00;  // порт A на вход
    PORTA = 0xFF; // подтяжки
    DDRD |= 0x03; // биты 0 и 1 порта D на выход
    while (1)
    {
        uint8_t in = (uint8_t)~PINA; // нажатые кнопки как единицы
        uint8_t c = (uint8_t)((in >> 2) & 0x01);
        if (c && !prev_c) // фронт такта
        {
            _delay_ms(20); // антидребезг
            in = (uint8_t)~PINA;
            if (((in >> 2) & 0x01) != 0)
            {
                uint8_t j = (uint8_t)(in & 0x01);
                uint8_t k = (uint8_t)((in >> 1) & 0x01);
                if (j && !k)
                    q = 1; // установка
                else if (!j && k)
                    q = 0; // сброс
                else if (j && k)
                    q = (uint8_t)!q; // переключение
                // при J равном 0 и K равном 0 состояние хранится
            }
        }
        prev_c = c;
        if (q)
            PORTD = (uint8_t)((PORTD & 0xFC) | 0x01); // Q равен 1
        else
            PORTD = (uint8_t)((PORTD & 0xFC) | 0x02); // Q равен 0
    }
}
